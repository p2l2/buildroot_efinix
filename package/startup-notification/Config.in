## package/startup-notification/Config.in
```kconfig
config BR2_STARTUP_NOTIFICATION_VERSION_0_9
	bool "startup-notification 0.9"

config BR2_STARTUP_NOTIFICATION_VERSION_0_12
	bool "startup-notification 0.12"

config BR2_STARTUP_NOTIFICATION_VERSION
	string
	default "0.9"	if BR2_STARTUP_NOTIFICATION_VERSION_0_9
	default "0.12"	if BR2_STARTUP_NOTIFICATION_VERSION_0_12

config BR2_PACKAGE_STARTUP_NOTIFICATION
	bool "startup-notification"
	depends on BR2_PACKAGE_XORG7
	depends on BR2_USE_MMU # fork()
	select BR2_PACKAGE_XLIB_LIBX11
	help
	  Startup-notification is a library used to monitor
	  application startup.

	  http://freedesktop.org/software/startup-notification/releases
```
